/*
 * Copyright (C) 2013 Nathaniel R. Lewis - http://nathanielrlewis.com/
 *
 * This program is free software; you can redistribute it and/or modify
 * it under the terms of the GNU General Public License version 2 as
 * published by the Free Software Foundation.
 * 
 * Enable eQEP2 on the Beaglebone White and Black
 * These pins don't conflict with the HDMI
 */

        
&epwmss2 {
	status = "okay";
};

    
&eqep2 {

	compatible = "ti,beaglebone", "ti,beaglebone-black", "ti,am33xx-eqep";

    	/* identification */
    	part-number = "bone_eqep2b";
    	version     = "00A0";

	pinctrl-names = "default";
        pinctrl-0 = <>;
            
        count_mode = <0>;  /* 0 - Quadrature mode, normal 90 phase offset cha & chb.  1 - Direction mode.  cha input = clock, chb input = direction */
        swap_inputs = <0>; /* Are channel A and channel B swapped? (0 - no, 1 - yes) */
        invert_qa = <0>;   /* Should we invert the channel A input?  */
        invert_qb = <0>;   /* Should we invert the channel B input?  */
        invert_qi = <0>;   /* Should we invert the index input? */
        invert_qs = <0>;   /* Should we invert the strobe input? */
            
        status = "okay";
};

